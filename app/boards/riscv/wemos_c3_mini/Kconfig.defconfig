## app/boards/riscv/wemos_c3_mini/Kconfig.defconfig
```kconfig
# ESP32S2 LOLIN S2 MINI board configuration

# Copyright (c) 2023 Google, LLC
# SPDX-License-Identifier: Apache-2.0

config BOARD
	default "wemos_c3_mini"
	depends on BOARD_WEMOS_C3_MINI

config ENTROPY_GENERATOR
	default y

config HEAP_MEM_POOL_SIZE
	default 98304 if WIFI
	default 16384 if BT
	default 4096

choice BT_HCI_BUS_TYPE
	default BT_ESP32 if BT
endchoice
```

## boards/riscv/wemos_c3_mini/Kconfig.board
```kconfig
# SPDX-License-Identifier: Apache-2.0

config BOARD_WEMOS_C3_MINI
	bool "WEMOS C3 Mini Board"
	depends on SOC_ESP32C3
```

## drivers/Kconfig
```kconfig
rsource "serial/Kconfig"
rsource "gpio/Kconfig"
rsource "sensor/Kconfig"

if MFD

module = MFD
module-str = mfd
source "subsys/logging/Kconfig.template.log_config"

endif

rsource "mfd/Kconfig"
```

## drivers/gpio/sc16is7xx/Kconfig
```kconfig
# SPDX-License-Identifier: Apache-2.0

menuconfig GPIO_SC16IS7XX
  bool "GPIO Bridge device for the SC16IS7XX Single/Dual UART bridge with I2C-bus/SPI interface"
  default y
  depends on MFD_SC16IS7XX && (\
      DT_HAS_NXP_SC16IS750_GPIO_CONTROLLER_ENABLED \
      || DT_HAS_NXP_SC16IS760_GPIO_CONTROLLER_ENABLED \
      || DT_HAS_NXP_SC16IS752_GPIO_CONTROLLER_ENABLED \
      || DT_HAS_NXP_SC16IS762_GPIO_CONTROLLER_ENABLED \
    )
	select MFD
  select GPIO
  help
    Enable driver for SC16IS7XX I2C- or SPI- based Single/Dual GPIO bridge with I2C-bus/SPI interface.

if GPIO_SC16IS7XX

config GPIO_SC16IS7XX_INIT_PRIORITY
  int "SC16IS7XX GPIO controller initialization priority"
  default 77
  help
    Sets the children GPIO controllers' initialization priorities.

    The priority MUST be higher in value (ie. lower in priority) than
    MFD_SC16IS7XX_DEVICE_INIT_PRIORITY.

    If UART is also used, it's advised for GPIO's priority to be LOWER
    (ie. higher in value) than UART_SC16IS7XX_INIT_PRIORITY, as the UART
    is generally the main use case for this chip, and therefore, should
    also be taken as a priority if GPIO ports collide with modem flow
    control ports.

endif
```

## drivers/mfd/sc16is7xx/Kconfig
```kconfig
# SPDX-License-Identifier: Apache-2.0

config MFD_SC16IS7XX
	bool "SC16IS7XX Single/Dual UART bridge with I2C-bus/SPI interface"
	default y
	depends on (\
		DT_HAS_NXP_SC16IS740_ENABLED \
		|| DT_HAS_NXP_SC16IS750_ENABLED \
		|| DT_HAS_NXP_SC16IS760_ENABLED \
		|| DT_HAS_NXP_SC16IS752_ENABLED \
		|| DT_HAS_NXP_SC16IS762_ENABLED \
	)
	select MFD
	select I2C \
		if $(dt_compat_on_bus,$(DT_COMPAT_NXP_SC16IS740),i2c) \
		|| $(dt_compat_on_bus,$(DT_COMPAT_NXP_SC16IS750),i2c) \
		|| $(dt_compat_on_bus,$(DT_COMPAT_NXP_SC16IS760),i2c) \
		|| $(dt_compat_on_bus,$(DT_COMPAT_NXP_SC16IS752),i2c) \
		|| $(dt_compat_on_bus,$(DT_COMPAT_NXP_SC16IS762),i2c)
	select SPI \
		if $(dt_compat_on_bus,$(DT_COMPAT_NXP_SC16IS740),spi) \
		|| $(dt_compat_on_bus,$(DT_COMPAT_NXP_SC16IS750),spi) \
		|| $(dt_compat_on_bus,$(DT_COMPAT_NXP_SC16IS760),spi) \
		|| $(dt_compat_on_bus,$(DT_COMPAT_NXP_SC16IS752),spi) \
		|| $(dt_compat_on_bus,$(DT_COMPAT_NXP_SC16IS762),spi)
	select GPIO \
		if $(dt_node_has_prop,$(DT_COMPAT_NXP_SC16IS740),interrupt-gpios)
	help
		Enable driver for SC16IS7XX I2C- or SPI- based Single/Dual UART
		bridge with I2C-bus/SPI interface.

if MFD_SC16IS7XX

config MFD_SC16IS7XX_DEVICE_INIT_PRIORITY
	int "SC16IS7XX GPIO controller initialization priority"
	default 60
	help
		Sets the MFD driver's initialization priority.

		The priority MUST be higher in value (ie. lower in priority) than
		either the SPI or I2C drivers being used.

choice MFD_SC16IS7XX_INTERRUPT_TRIGGER
	prompt "Interrupt mode"
	default MFD_SC16IS7XX_INTERRUPT_TRIGGER_AUTO
	help
		Specify the type of interrupt handling to be used by the driver.

config MFD_SC16IS7XX_INTERRUPT_TRIGGER_NONE
	bool "Do not treat interrupts"

config MFD_SC16IS7XX_INTERRUPT_TRIGGER_AUTO
	bool "Select mode automatically, depending on devicetree configuration"
	select MFD_SC16IS7XX_INTERRUPT

endchoice # MFD_SC16IS7XX_INTERRUPT_THREAD

config MFD_SC16IS7XX_INTERRUPT_TRIGGER_NO_POLLING
	bool "Prohibits use of interrupt polling when triggering is automatic"

config MFD_SC16IS7XX_INTERRUPT_POLLING_PERIOD
	int "Polling interrupt mode's wait time"
	default 1000
	help
		Default polling period, in nanoseconds.

choice MFD_SC16IS7XX_INTERRUPT_THREAD
	prompt "Interrupt threading mode"
	default MFD_SC16IS7XX_INTERRUPT_OWN_THREAD
	depends on MFD_SC16IS7XX_INTERRUPT
	help
		Specify the type of interrupt handling to be used by the driver.
		The interrupt work queue, if created, MAY BE shared amongst all of
		the device' children (ie. UART and GPIO devices).

config MFD_SC16IS7XX_INTERRUPT_GLOBAL_THREAD
	bool "Use global thread"

config MFD_SC16IS7XX_INTERRUPT_OWN_THREAD
	bool "Use own thread"

endchoice # MFD_SC16IS7XX_INTERRUPT_MODE

config MFD_SC16IS7XX_INTERRUPT
	bool

config MFD_SC16IS7XX_INTERRUPT_THREAD_PRIORITY
	int "Thread priority"
	depends on MFD_SC16IS7XX_INTERRUPT_OWN_THREAD
	default 5
	help
		Priority of thread used by the driver to handle interrupts.

config MFD_SC16IS7XX_INTERRUPT_THREAD_STACK_SIZE
	int "Thread stack size"
	depends on MFD_SC16IS7XX_INTERRUPT_OWN_THREAD
	default 1024
	help
		Stack size of thread used by the driver to handle interrupts.

endif # MFD_SC16IS7XX
```

## drivers/sensor/ens160/Kconfig
```kconfig
# ENS160 temperature, pressure, humidity and gas sensor configuration options

# Copyright (c) 2018 Bosch Sensortec GmbH
# Copyright (c) 2022, Leonard Pollak
#
# SPDX-License-Identifier: Apache-2.0

menuconfig ENS160
	bool "ENS160 Digital Metal-Oxide Multi-Gas Sensor"
	default y
	depends on DT_HAS_SCIOSENSE_ENS160_ENABLED
  select SENSOR
	select I2C if $(dt_compat_on_bus,$(DT_COMPAT_SCIOSENSE_ENS160),i2c)
	select SPI if $(dt_compat_on_bus,$(DT_COMPAT_SCIOSENSE_ENS160),spi)
	help
	  Enable driver for ENS160 I2C- or SPI- based TVOC, eCO2 and AQI-UBA and gas sensor.

if ENS160
  config ENS160_FORCE_OPMODE
    bool "Forces changing the device's OPMODE for each measurement cycle"
    help
      Forces the device to enter a specific OPMODE for each measurement cycle.
endif
```

## drivers/serial/sc16is7xx/Kconfig
```kconfig
# SPDX-License-Identifier: Apache-2.0

config UART_SC16IS7XX
  bool "UART Bridge device for the SC16IS7XX Single/Dual UART bridge with I2C-bus/SPI interface"
  default y
  depends on MFD_SC16IS7XX && (\
      DT_HAS_NXP_SC16IS740_UART_CONTROLLER_ENABLED \
      || DT_HAS_NXP_SC16IS750_UART_CONTROLLER_ENABLED \
      || DT_HAS_NXP_SC16IS760_UART_CONTROLLER_ENABLED \
      || DT_HAS_NXP_SC16IS752_UART_CONTROLLER_ENABLED \
      || DT_HAS_NXP_SC16IS762_UART_CONTROLLER_ENABLED \
    )
	select MFD
  select UART
  select SERIAL
  select SERIAL_HAS_DRIVER
  help
    Enable driver for SC16IS7XX I2C- or SPI- based Single/Dual UART bridge with I2C-bus/SPI interface.

if UART_SC16IS7XX

config UART_SC16IS7XX_INIT_PRIORITY
  int "SC16IS7XX UART controller initialization priority"
  default 75
  help
    Sets the children UART controllers' initialization priorities.

    The priority MUST be higher in value (ie. lower in priority) than
    MFD_SC16IS7XX_DEVICE_INIT_PRIORITY.

    If GPIO is also used, it's advised for UART's priority to be HIGHER
    (ie. lower in value) than GPIO_SC16IS7XX_INIT_PRIORITY, as the UART
    is generally the main use case for this chip, and therefore, should
    also be taken as a priority if GPIO ports collide with modem flow
    control ports.

config CONFIG_UART_SC16IS7XX_LINE_CTRL
  bool "SC16IS7XX UART controller interrupt controls"
  default y
  depends on CONFIG_UART_LINE_CTRL

config CONFIG_UART_SC16IS7XX_USE_RUNTIME_CONFIGURE
  bool "SC16IS7XX UART controller runtime configuration"
  default y
  depends on CONFIG_UART_USE_RUNTIME_CONFIGURE

config UART_SC16IS7XX_INTERRUPT_DRIVEN
  bool "SC16IS7XX UART controller interrupt controls"
  default y
  depends on MFD_SC16IS7XX_INTERRUPT && UART_INTERRUPT_DRIVEN
  help
    Activates UART interrupt-driven controls.

    Although the device itself won't manage interrupts directly (as it is
    shared amongst bridges, which necessitates centralized control through
    a corresponding MFD driver), activating UART_INTERRUPT_DRIVEN is
    still necessary, in order to keep consistency with other device drivers
    of the same nature.

    Likewise, interrupts on the MFD must also be enabled, via
    MFD_SC16IS7XX_INTERRUPT. Although this flag is automatically selected,
    your device declaration in the devicetree must also be configured with
    at least one means of hardware interrupts (e.g. GPIO interrupts) in
    order for interrupt-driven controls to be enabled in the children/bridges.

config UART_SC16IS7XX_ASYNC_API
  bool "SC16IS7XX UART controller asynchronous communication"
  default y
  depends on UART_ASYNC_API
  help
    Activates UART asyncrhonous controls.

config MFD_SC16IS7XX_ASYNC_THREAD_PRIORITY
	int "Async API's Thread priority"
	depends on UART_SC16IS7XX_ASYNC_API
	default 5
	help
	  Priority of thread used by the driver to handle the Async API operations.

config MFD_SC16IS7XX_ASYNC_THREAD_STACK_SIZE
	int "Async API's Thread stack size"
	depends on UART_SC16IS7XX_ASYNC_API
	default 1024
	help
	  Stack size of thread used by the driver to handle the Async API operations.

endif
```

## dts/bindings/gpio/nxp,sc16is752-gpio-controller.yml
```yaml
# SPDX-License-Identifier: Apache-2.0

include: ["nxp,sc16is7xx-gpio-controller.yml"]

compatible: "nxp,sc16is752-gpio-controller"
on-bus: nxp,sc16is752

description: GPIO controller part for the SC16IS752 UART bridge

properties:
  channel:
    enum:
      - 0
      - 1
```

## dts/bindings/gpio/nxp,sc16is760-gpio-controller.yml
```yaml
# SPDX-License-Identifier: Apache-2.0

include: ["nxp,sc16is7xx-gpio-controller.yml"]

compatible: "nxp,sc16is760-gpio-controller"
on-bus: nxp,sc16is760

description: GPIO controller part for the SC16IS760 UART bridge

properties:
  channel:
    enum:
      - 0
      - 1
```

## dts/bindings/gpio/nxp,sc16is762-gpio-controller.yml
```yaml
# SPDX-License-Identifier: Apache-2.0

include: ["nxp,sc16is7xx-gpio-controller.yml"]

compatible: "nxp,sc16is762-gpio-controller"
on-bus: nxp,sc16is762

description: GPIO controller part for the SC16IS762 UART bridge

properties:
  channel:
    enum:
      - 0
      - 1
```

## dts/bindings/gpio/nxp,sc16is7xx-gpio-controller.yml
```yaml
# SPDX-License-Identifier: Apache-2.0

include: [gpio-controller.yaml]

description: GPIO controller part for the SC16IS7XX UART bridge

properties:
  "#gpio-cells":
    required: true
    const: 2

  channel:
    type: int
    required: true
    description: |
      The GPIO's port number.

      GPIO pins are arranged as such:

      - Port 0: GPIO pins 0 through 3
      - Port 1: GPIO pins 4 through 7

  ngpios:
    required: true
    const: 4

gpio-cells:
  - pin
  - flags
```

## dts/bindings/mfd/nxp,sc16is740-i2c.yml
```yaml
# SPDX-License-Identifier: Apache-2.0

include: ["nxp,sc16is7xx.yml", sensor-device.yaml, i2c-device.yaml]

description: NXP SC16IS740 I2C to UART bridge (I2C tnterface).

compatible: "nxp,sc16is740-i2c"
bus: nxp,sc16is740
on-bus: i2c

properties:
  part-number:
    default: sc16is740
    const: sc16is740

  'total-uart-channels':
    type: int
    const: 1
    default: 1

  'total-gpio-channels':
    type: int
    const: 0
    default: 0

  supports-modem-flow-control:
    type: int
    const: 0
    default: 0

  shared-gpio-channels:
    type: array
    const: []
    default: []
```

## dts/bindings/mfd/nxp,sc16is740-spi.yml
```yaml
# SPDX-License-Identifier: Apache-2.0

include: ["nxp,sc16is7xx.yml", sensor-device.yaml, spi-device.yaml]

compatible: "nxp,sc16is740"
bus: nxp,sc16is740
on-bus: spi

properties:
  part-number:
    default: sc16is740
    const: sc16is740

  'total-uart-channels':
    type: int
    const: 1
    default: 1

  'total-gpio-channels':
    type: int
    const: 0
    default: 0

  supports-modem-flow-control:
    type: int
    const: 0
    default: 0

  shared-gpio-channels:
    type: array
    const: []
    default: []

  spi-max-frequency:
    type: int
    default: 4000000
```

## dts/bindings/mfd/nxp,sc16is750-i2c.yml
```yaml
# SPDX-License-Identifier: Apache-2.0

include: ["nxp,sc16is7xx.yml", sensor-device.yaml, i2c-device.yaml]

compatible: "nxp,sc16is750"
bus: nxp,sc16is750
on-bus: i2c

properties:
  part-number:
    default: sc16is750
    const: sc16is750

  'total-uart-channels':
    type: int
    const: 1
    default: 1

  'total-gpio-channels':
    type: int
    const: 2
    default: 2

  supports-modem-flow-control:
    type: int
    const: 1
    default: 1

  shared-gpio-channels:
    type: array
    const:
      - 1
    default:
      - 1
```

## dts/bindings/mfd/nxp,sc16is752-i2c.yml
```yaml
# SPDX-License-Identifier: Apache-2.0

include: ["nxp,sc16is7xx.yml", sensor-device.yaml, i2c-device.yaml]

compatible: "nxp,sc16is752"
bus: nxp,sc16is752
on-bus: i2c

properties:
  part-number:
    default: sc16is752
    const: sc16is752

  'total-uart-channels':
    type: int
    const: 2
    default: 2

  'total-gpio-channels':
    type: int
    const: 2
    default: 2

  supports-modem-flow-control:
    type: int
    const: 1
    default: 1

  shared-gpio-channels:
    type: array
    const:
      - 0
      - 1
    default:
      - 0
      - 1
```

## dts/bindings/mfd/nxp,sc16is752-spi.yml
```yaml
# SPDX-License-Identifier: Apache-2.0

include: ["nxp,sc16is7xx.yml", sensor-device.yaml, spi-device.yaml]

description: NXP SC16IS752 SPI to UART bridge (SPI tnterface).

compatible: "nxp,sc16is752-spi"
bus: nxp,sc16is752
on-bus: spi

properties:
  part-number:
    default: sc16is752
    const: sc16is752

  'total-uart-channels':
    type: int
    const: 2
    default: 2

  'total-gpio-channels':
    type: int
    const: 2
    default: 2

  supports-modem-flow-control:
    type: int
    const: 1
    default: 1

  shared-gpio-channels:
    type: array
    const:
      - 0
      - 1
    default:
      - 0
      - 1

  spi-max-frequency:
    type: int
    default: 4000000
```

## dts/bindings/mfd/nxp,sc16is760-i2c.yml
```yaml
# SPDX-License-Identifier: Apache-2.0

include: ["nxp,sc16is7xx.yml", sensor-device.yaml, i2c-device.yaml]

description: NXP SC16IS760 I2C to UART bridge (I2C tnterface).

compatible: "nxp,sc16is760-i2c"
bus: nxp,sc16is760
on-bus: i2c

properties:
  part-number:
    default: sc16is760
    const: sc16is760

  'total-uart-channels':
    type: int
    const: 1
    default: 1

  'total-gpio-channels':
    type: int
    const: 2
    default: 2

  supports-modem-flow-control:
    type: int
    const: 1
    default: 1

  shared-gpio-channels:
    type: array
    const:
      - 1
    default:
      - 1
```

## dts/bindings/mfd/nxp,sc16is760-spi.yml
```yaml
# SPDX-License-Identifier: Apache-2.0

include: ["nxp,sc16is7xx.yml", sensor-device.yaml, spi-device.yaml]

description: NXP SC16IS760 SPI to UART bridge (SPI tnterface).

compatible: "nxp,sc16is760-spi"
bus: nxp,sc16is760
on-bus: spi

properties:
  part-number:
    default: sc16is760
    const: sc16is760

  'total-uart-channels':
    type: int
    const: 1
    default: 1

  'total-gpio-channels':
    type: int
    const: 2
    default: 2

  supports-modem-flow-control:
    type: int
    const: 1
    default: 1

  shared-gpio-channels:
    type: array
    const:
      - 1
    default:
      - 1

  spi-max-frequency:
    type: int
    default: 15000000
```
