## dts/bindings/uart/nxp,sc16is750-uart-controller.yml
```yaml
# SPDX-License-Identifier: Apache-2.0

include: ["nxp,sc16is7xx-uart-controller.yml"]

description: UART controller part for the SC16IS750 UART bridge

compatible: "nxp,sc16is750-uart-controller"
on-bus: nxp,sc16is750

properties:
  channel:
    enum:
      - 0
```

## dts/bindings/uart/nxp,sc16is752-uart-controller.yml
```yaml
# SPDX-License-Identifier: Apache-2.0

include: ["nxp,sc16is7xx-uart-controller.yml"]

description: UART controller part for the SC16IS752 UART bridge

compatible: "nxp,sc16is752-uart-controller"
on-bus: nxp,sc16is752

properties:
  channel:
    enum:
      - 0
      - 1

  supports-irda-fast-speed:
    type: int
    const: 0
    default: 0
```

## dts/bindings/uart/nxp,sc16is760-uart-controller.yml
```yaml
# SPDX-License-Identifier: Apache-2.0

include: ["nxp,sc16is7xx-uart-controller.yml"]

description: UART controller part for the SC16IS760 UART bridge

compatible: "nxp,sc16is760-uart-controller"
on-bus: nxp,sc16is760

properties:
  channel:
    enum:
      - 0

  supports-irda-fast-speed:
    type: boolean
    const: true
    default: true

  allow-irda-fast-speed:
    type: boolean
    description: |
      Allows Fast (IrDA MIR) speeds, when `irda-transceiver` is enabled.

      This option is in place because SC16IS7XX's fast-speed modes are NOT compatible with the
      IrDA standard, therefore, the user must explicitly enable it in order to reduce conflicts.
```

## dts/bindings/uart/nxp,sc16is762-uart-controller.yml
```yaml
# SPDX-License-Identifier: Apache-2.0

include: ["nxp,sc16is7xx-uart-controller.yml"]

description: UART controller part for the SC16IS762 UART bridge

compatible: "nxp,sc16is762-uart-controller"
on-bus: nxp,sc16is762

properties:
  channel:
    enum:
      - 0
      - 1

  supports-irda-fast-speed:
    type: int
    const: 1
    default: 1

  irda-pulse-width:
    type: string
    default: "3/16"
    description: |
      Sets TX/RX pulse width, when `irda-transceiver` is enabled.

      For "auto", the pulse width will be selected when the baud rate is set to any
      speed greater than 115.2Kbps.

      This option (and its "3/16" default) is in place because SC16IS7XX's fast-speed
      modes are NOT compatible with the IrDA standard, therefore, the user must
      explicitly enable it in order to reduce conflicts.
    enum:
      - auto
      - "3/16"
      - "1/4"
```
